## meta-brands/meta-edision2/conf/layer.conf
```bitbake
# We have a conf and classes directory, append to BBPATH
BBPATH .= ":${LAYERDIR}"

# We have a recipes directory, add to BBFILES
BBFILES += "${LAYERDIR}/recipes-*/*.bb ${LAYERDIR}/recipes-*/*.bbappend \
            ${LAYERDIR}/recipes-*/*/*.bb ${LAYERDIR}/recipes-*/*/*.bbappend"

BBFILE_COLLECTIONS += "edision2-layer"
BBFILE_PATTERN_edision2-layer := "^${LAYERDIR}/"
BBFILE_PRIORITY_edision2-layer = "7"

LAYERSERIES_COMPAT_edision2-layer = "thud"

OEA-META-EDISION2-BASE := '${@os.path.normpath("${LAYERDIR}/")}'
```

## meta-brands/meta-edision2/conf/machine/osninoali.conf
```bitbake
#@TYPE: Machine
#@NAME: Edision OSNINO
#@DESCRIPTION: Machine configuration for the Edision OSNINO

MACHINE_NAME = "E"

FLASHSIZE = "512"

PREFERRED_VERSION_linux-edisionali = "3.12.74"
PREFERRED_VERSION_linux-libc-headers = "3.12.74.ali"

SOC_FAMILY = "ali3527"

UBI_VOLNAME = "rootfs"
MKUBIFS_ARGS = "-m 2048 -e 126976 -c 4096 -F"
UBINIZE_ARGS = "-m 2048 -p 128KiB"

### 8723BS wireless/bluetooth ###
KERNEL_MODULE_AUTOLOAD += "r8723bs" 

MACHINE_EXTRA_RRECOMMENDS += " \
    firmware-rtl8723b \
    "

DVBMEDIASINK_CONFIG = "--with-wma --with-wmv --with-pcm --with-dts --with-eac3"

require conf/machine/include/edisionali.inc

MACHINE_FEATURES += "videoenhancement skins1080 7segment textlcd dvb-c inibt aliaui blindscan-dvbs"
```

## meta-brands/meta-torch/conf/layer.conf
```bitbake
# We have a conf and classes directory, append to BBPATH
BBPATH .= ":${LAYERDIR}"

# We have a recipes directory, add to BBFILES
BBFILES += "${LAYERDIR}/recipes-*/*.bb ${LAYERDIR}/recipes-*/*.bbappend \
            ${LAYERDIR}/recipes-*/*/*.bb ${LAYERDIR}/recipes-*/*/*.bbappend"

BBFILE_COLLECTIONS += "torch-layer"
BBFILE_PATTERN_torch-layer := "^${LAYERDIR}/"
BBFILE_PRIORITY_torch-layer = "7"

LAYERSERIES_COMPAT_torch-layer = "thud"

OEA-META-TORCH-BASE := '${@os.path.normpath("${LAYERDIR}/")}'
```

## meta-brands/meta-torch/conf/machine/alie5000.conf
```bitbake
#@TYPE: Machine
#@NAME: ALI.E 5000
#@DESCRIPTION: Machine configuration for the TORCH ALI.E 5000

MACHINE_NAME = "ALI.E 5000"

FLASHSIZE = "512"

PREFERRED_VERSION_linux-torch = "3.12.74"
PREFERRED_VERSION_linux-libc-headers = "3.12.74.ali"

SOC_FAMILY = "alixxxx"

UBI_VOLNAME = "rootfs"
MKUBIFS_ARGS = "-m 2048 -e 126976 -c 4096 -F"
UBINIZE_ARGS = "-m 2048 -p 128KiB"

### 8723BS wireless/bluetooth ###
KERNEL_MODULE_AUTOLOAD += "r8723bs" 

MACHINE_EXTRA_RRECOMMENDS += " \
    firmware-rtl8723b \
    "

DVBMEDIASINK_CONFIG = "--with-wma --with-wmv --with-pcm --with-dts --with-eac3"

require conf/machine/include/torch.inc

MACHINE_FEATURES += "videoenhancement skins1080 7segment textlcd dvb-c inibt aliaui blindscan-dvbs"
```
